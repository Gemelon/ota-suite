## components/network_manager/Kconfig
```kconfig
menu "OTA Suite network"
    config OTA_SUITE_AP_SSID_PREFIX
        string "Setup access point SSID prefix"
        default "OTASuite"
        help
            The full setup AP name appends a hyphen and the last three Wi-Fi MAC
            bytes. Keep the resulting SSID within the 32-byte Wi-Fi limit.
    config OTA_SUITE_AP_PASSWORD
        string "Access point / web admin password (empty: generate and store)"
        default ""
        help
            Use 8 to 63 characters. If empty, a random password is generated
            once, stored in NVS, and printed on the serial console.
            The web interface uses username admin and this same password.
    config OTA_SUITE_SNTP_SERVER
        string "Time server for HTTPS certificate validation"
        default "pool.ntp.org"
endmenu
```

## components/ota_manager/Kconfig
```kconfig
# SPDX-FileCopyrightText: 2026 Thomas Stoll
# SPDX-License-Identifier: Apache-2.0

menu "OTA Suite firmware updates"
    config OTA_SUITE_OTA_ALLOW_HTTP
        bool "Allow unencrypted HTTP OTA (local testing only)"
        default n
        select ESP_HTTPS_OTA_ALLOW_HTTP
        help
            HTTP cannot authenticate the firmware server or protect against
            firmware replacement in transit. Only use on a trusted test LAN.
            HTTPS certificate validation remains enabled for HTTPS URLs.
endmenu
```

## components/status_led/Kconfig
```kconfig
# SPDX-FileCopyrightText: 2026 Thomas Stoll
# SPDX-License-Identifier: Apache-2.0

menu "OTA Suite status LED"
    config OTA_SUITE_STATUS_LED_ENABLE
        bool "Enable the OTA status LED"
        default n
        help
            Enable the optional WS2812 RGB status indicator.
    config OTA_SUITE_LED_GPIO
        int "Onboard WS2812 RGB LED GPIO"
        range 0 48
        default 48
        help
            ESP32-S3-DevKitC-1 normally uses GPIO48.
            Some board revisions use GPIO38. Check your board schematic.
endmenu
```

## components/update_check/Kconfig
```kconfig
# SPDX-FileCopyrightText: 2026 Thomas Stoll
# SPDX-License-Identifier: Apache-2.0

menu "OTA Suite update checks"
    config OTA_SUITE_UPDATE_MANIFEST_URL
        string "Fixed firmware manifest URL"
        default "https://updates.example.org/firmware.json"
        help
            Only the manifest is fetched automatically. Images must be in the same
            directory and origin as this URL and named <project>-<version>.bin.
            HTTP requires OTA_SUITE_OTA_ALLOW_HTTP; HTTPS requires valid CA/date checks.
endmenu
```

## components/web_interface/Kconfig
```kconfig
# SPDX-FileCopyrightText: 2026 Thomas Stoll
# SPDX-License-Identifier: Apache-2.0

menu "OTA Suite web interface"
    config OTA_SUITE_WEB_PASSWORD
        string "Initial web login password"
        default "ebctester"
        help
            Initial admin password for login and settings confirmation.
            Use 8-63 printable ASCII characters without leading or trailing
            spaces. A password saved through
            Login Settings takes precedence and survives firmware updates.
            This does not change the setup access point password.
    config OTA_SUITE_WEB_SETTINGS_REQUIRE_PASSWORD
        bool "Require admin password when saving web settings"
        default y
        help
            Require the configured web admin password for every settings save,
            even when browser login is disabled, in addition to a CSRF token
            and a valid session when login is enabled. Extensions
            must use web_interface_authorize_settings_request for settings.
            This does not affect test controls, uploads or OTA actions.
    config OTA_SUITE_WEB_SD_LANGUAGES
        bool "Enable optional SD language provider"
        default n
        help
            The consuming application must register authenticated
            /api/i18n/languages and /api/i18n/language endpoints before startup.
            Without this option the built-in English and German UI is standalone.
    config OTA_SUITE_WEB_PRIMARY_TABS
        string "Tabs in the primary navigation section (empty disables sections)"
        default ""
        help
            Comma-separated tab ids for the Batterietester section.
            Other tabs appear under Verwaltung.
    config OTA_SUITE_WEB_ACTIVITY_URL
        string "Optional frame status endpoint for the header activity LED"
        default ""
        help
            Same-origin endpoint returning link.connected, link.framesOk and
            link.ageMs. Empty disables the activity indicator.
    config OTA_SUITE_WEB_TAB_ORDER
        string "Web interface tab order"
        default "overview,updates,settings"
        help
            Comma-separated tab ids in display order. Built-in tabs are
            overview, updates and settings; extension tabs use their registered
            id (for example sd-card). Unlisted tabs are appended. The first
            listed tab is opened when the page loads.
endmenu
```

## examples/esp32s3-starter/sdkconfig.defaults
```kconfig
CONFIG_IDF_TARGET="esp32s3"
CONFIG_ESPTOOLPY_FLASHSIZE_4MB=y
CONFIG_PARTITION_TABLE_CUSTOM=y
CONFIG_PARTITION_TABLE_CUSTOM_FILENAME="partitions.csv"
CONFIG_BOOTLOADER_APP_ROLLBACK_ENABLE=y
CONFIG_MBEDTLS_CERTIFICATE_BUNDLE=y
CONFIG_MBEDTLS_CERTIFICATE_BUNDLE_DEFAULT_FULL=y
CONFIG_ESP_HTTPS_OTA_ALLOW_HTTP=n
CONFIG_MBEDTLS_HAVE_TIME_DATE=y
CONFIG_OTA_SUITE_UPDATE_MANIFEST_URL="https://updates.example.org/firmware.json"
```
